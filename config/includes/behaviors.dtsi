// sourced from urob/zmk-node-free
#define ZMK_STRINGIFY(x) #x
#define ZMK_BEHAVIOR_CORE_caps_word       compatible = "zmk,behavior-caps-word";       #binding-cells = <0>
#define ZMK_BEHAVIOR_CORE_dynamic_macro   compatible = "zmk,behavior-dynamic-macro";   #binding-cells = <1>
#define ZMK_BEHAVIOR_CORE_hold_tap        compatible = "zmk,behavior-hold-tap";        #binding-cells = <2>
#define ZMK_BEHAVIOR_CORE_key_repeat      compatible = "zmk,behavior-key-repeat";      #binding-cells = <0>
#define ZMK_BEHAVIOR_CORE_macro           compatible = "zmk,behavior-macro";           #binding-cells = <0>
#define ZMK_BEHAVIOR_CORE_macro_one_param compatible = "zmk,behavior-macro-one-param"; #binding-cells = <1>
#define ZMK_BEHAVIOR_CORE_macro_two_param compatible = "zmk,behavior-macro-two-param"; #binding-cells = <2>
#define ZMK_BEHAVIOR_CORE_mod_morph       compatible = "zmk,behavior-mod-morph";       #binding-cells = <0>
#define ZMK_BEHAVIOR_CORE_sticky_key      compatible = "zmk,behavior-sticky-key";      #binding-cells = <1>
#define ZMK_BEHAVIOR_CORE_tap_dance       compatible = "zmk,behavior-tap-dance";       #binding-cells = <0>
#define ZMK_BEHAVIOR_CORE_tri_state       compatible = "zmk,behavior-tri-state";       #binding-cells = <0>

#define ZMK_BEHAVIOR(name, type, ...) \
  / { \
    behaviors { \
      name: name { \
        label = ZMK_STRINGIFY(ZB_ ## name); \
        ZMK_BEHAVIOR_CORE_ ## type; \
        __VA_ARGS__ \
      }; \
    }; \
  };

#define GLOBAL_QUICK_TAP_MS 175

// ## configure behaviors
&sk {
  quick-release;
};

// ## new behaviors

// ### timerless home row mods
// see https://github.com/urob/zmk-config#timeless-homerow-mods
#define MAKE_HRM(NAME, HOLD, TAP, TRIGGER_POS) \
  ZMK_BEHAVIOR(NAME, hold_tap, \
    flavor = "balanced"; \
    tapping-term-ms = <280>; \
    quick-tap-ms = <GLOBAL_QUICK_TAP_MS>; \
    require-prior-idle-ms = <150>; \
    bindings = <HOLD>, <TAP>; \
    hold-trigger-key-positions = <TRIGGER_POS>; \
    hold-trigger-on-release; \
  )

MAKE_HRM(hml, &kp, &kp, LEFT_KEYS THUMB_KEYS)    // left-hand HRMs
MAKE_HRM(hmr, &kp, &kp, RIGHT_KEYS THUMB_KEYS)  // right-hand HRMs

// ### bluetooth select/clear

// Make a BlueTooth Select/Clear morph
// tap = select,
// shift + tap = select and clear
// not sure why these are not working...
#define MAKE_BTSC(NAME, SEL) \
  ZMK_BEHAVIOR(NAME, mod_morph, \
    bindings = <&bt BT_SEL SEL>, <&bt BT_SEL SEL &bt BT_CLR>; \
    mods = <(MOD_LSFT|MOD_RSFT)>; \
  )

MAKE_BTSC(btsc_0, 0) // select 0th profile
MAKE_BTSC(btsc_1, 1) // select 1st profile
MAKE_BTSC(btsc_2, 2) // etc...
MAKE_BTSC(btsc_3, 3)
MAKE_BTSC(btsc_4, 4)

// ### new shift morphs

// Tap for comma, shift + tap for semicolon
ZMK_BEHAVIOR(cma_smi, mod_morph, \
  bindings = <&kp COMMA>, <&kp SEMI>; \
  mods = <(MOD_LSFT)>; \
)
// Tap for period, shift + tap for colon
ZMK_BEHAVIOR(dot_cln, mod_morph, \
  bindings = <&kp DOT>, <&kp COLON>; \
  mods = <(MOD_LSFT)>; \
)

// ### layer toggles

// layer toggle/repeat
// hold = toggle to layer
// tap = repeat last key
// you can't use key_repeat directly with &lt, because lt expects a &kp for the second binding
// use: &ltr SOME_LAYER 0
// the zero is required to make the binding valid
ZMK_BEHAVIOR(ltr, hold_tap, \
  flavor = "balanced"; \
  tapping-term-ms = <280>; \
  quick-tap-ms = <GLOBAL_QUICK_TAP_MS>; \
  bindings = <&mo>, <&key_repeat>; \
)

// layer toggle/ sticky key
// hold = toggle to layer
// tap = sticky key
ZMK_BEHAVIOR(ltsk, hold_tap, \
  flavor = "balanced"; \
  tapping-term-ms = <280>; \
  quick-tap-ms = <GLOBAL_QUICK_TAP_MS>; \
  bindings = <&mo>, <&sk>; \
)
